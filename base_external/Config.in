## base_external/package/final-device/Config.in
```kconfig
config BR2_PACKAGE_FINAL_DEVICE
	bool "final-device"
	help
	  Includes the final device drivers and application
```

## base_external/package/reed-switch-device/Config.in
```kconfig
config BR2_PACKAGE_REED_SWITCH_DEVICE
	bool "reed-switch-device"
	help
	  Includes the reed switch driver
```
